## config/west.yml
```yaml
manifest:
  remotes:
    - name: zmkfirmware
      url-base: https://github.com/zmkfirmware
    - name: gohanda11
      url-base: https://github.com/gohanda11
  projects:
    - name: zmk
      remote: zmkfirmware
      revision: main
      revision: v3.5.0
      import: app/west.yml
    - name: zmk-pmw3610-driver
      remote: gohanda11
  self:
    path: config
```
